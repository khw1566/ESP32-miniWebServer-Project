## mini-WEB (C3-ESP-IDF_ver)/main/Kconfig.projbuild
```kconfig
menu "Mini WEB automatic cloud connection"
config MINI_WEB_RELAY_URL
    string "Factory cloud relay HTTPS endpoint"
    default "https://relay.audreaming.com"
config MINI_WEB_PUBLIC_DOMAIN
    string "Factory public domain"
    default "audreaming.com"
config MINI_WEB_PUBLIC_HOST
    string "Optional factory hostname (demo.audreaming.com for competition)"
    default ""
    help
        Empty uses c3-<board MAC>.PUBLIC_DOMAIN. Configure the matching Worker
        domain before shipment. Device token comes from factory NVS, never Wi-Fi UI.
endmenu
```

## mini-WEB (C3-ESP-IDF_ver)/sdkconfig.defaults
```kconfig
# ESP32-C3 (4MB Flash)
CONFIG_IDF_TARGET="esp32c3"

# Flash 크기: C3 기본 4MB
CONFIG_ESPTOOLPY_FLASHSIZE_4MB=y
CONFIG_ESPTOOLPY_FLASHSIZE="4MB"
CONFIG_ESPTOOLPY_FLASH_SAMPLE_MODE_STR=y

# 커스텀 파티션 테이블
CONFIG_PARTITION_TABLE_CUSTOM=y
CONFIG_PARTITION_TABLE_CUSTOM_FILENAME="partitions_4mb.csv"
CONFIG_PARTITION_TABLE_FILENAME="partitions_4mb.csv"

# HTTP 서버 설정
CONFIG_HTTPD_MAX_REQ_HDR_LEN=1024
CONFIG_HTTPD_MAX_URI_LEN=512

# 태스크 스택 설정 (C3 싱글코어 고려)
CONFIG_ESP_SYSTEM_EVENT_TASK_STACK_SIZE=4096
CONFIG_ESP_MAIN_TASK_STACK_SIZE=6144
CONFIG_FREERTOS_HZ=1000

# C3는 RISC-V 싱글코어 → 유니코어 FreeRTOS
CONFIG_FREERTOS_UNICORE=y

CONFIG_LWIP_IPV6=y

CONFIG_LWIP_IPV6_AUTOCONFIG=y

CONFIG_LWIP_IPV6_NUM_ADDRESSES=5

CONFIG_LWIP_ND6=y

CONFIG_ESP_WIFI_SOFTAP_SUPPORT=y
```

## mini-WEB (M1-ESP-IDF_ver)/main/Kconfig.projbuild
```kconfig
menu "Mini WEB automatic cloud connection"
config MINI_WEB_RELAY_URL
    string "Factory cloud relay HTTPS endpoint"
    default "https://relay.audreaming.com"
config MINI_WEB_PUBLIC_DOMAIN
    string "Factory public domain"
    default "audreaming.com"
config MINI_WEB_PUBLIC_HOST
    string "Optional factory hostname (demo.audreaming.com for competition)"
    default ""
    help
        Empty uses m1-<board MAC>.PUBLIC_DOMAIN. Configure the matching Worker
        domain before shipment. Device token comes from factory NVS, never Wi-Fi UI.
endmenu

menu "M1 speaker notifications"
config M1_SYSTEM_SOUNDS
    bool "Enable GPIO26 speaker notification melodies"
    default y
    help
        ESP32-2432S028R onboard amplifier speaker connector (DAC GPIO26).
        No SD card, audio files or network downloads are required.
config M1_SOUND_ATTENUATION
    int "DAC attenuation (0=loud, 1=-6dB, 2=-12dB, 3=-18dB)"
    range 0 3
    default 3
    depends on M1_SYSTEM_SOUNDS
endmenu
```

## mini-WEB (M1-ESP-IDF_ver)/sdkconfig.defaults
```kconfig
CONFIG_IDF_TARGET="esp32"
CONFIG_ESPTOOLPY_FLASHSIZE_4MB=y
CONFIG_PARTITION_TABLE_CUSTOM=y
CONFIG_PARTITION_TABLE_CUSTOM_FILENAME="partitions_4mb.csv"
CONFIG_HTTPD_MAX_REQ_HDR_LEN=1024
CONFIG_HTTPD_MAX_URI_LEN=512
CONFIG_ESP_MAIN_TASK_STACK_SIZE=8192
CONFIG_ESP_SYSTEM_EVENT_TASK_STACK_SIZE=4096
CONFIG_FREERTOS_HZ=1000
CONFIG_LWIP_IPV6=y
CONFIG_LWIP_IPV6_AUTOCONFIG=y
CONFIG_LWIP_IPV6_NUM_ADDRESSES=5
CONFIG_LV_COLOR_DEPTH_16=y
CONFIG_LV_COLOR_16_SWAP=y
CONFIG_LV_LAYER_SIMPLE_BUF_SIZE=4096
# CONFIG_LV_THEME_DEFAULT_GROW is not set
CONFIG_LV_FONT_MONTSERRAT_14=y
CONFIG_LV_MEM_CUSTOM=y
CONFIG_LV_MEM_CUSTOM_INCLUDE="stdlib.h"
CONFIG_LWIP_MAX_SOCKETS=16
CONFIG_ESP_WIFI_STATIC_RX_BUFFER_NUM=4
CONFIG_ESP_WIFI_DYNAMIC_RX_BUFFER_NUM=10
CONFIG_ESP_WIFI_DYNAMIC_TX_BUFFER_NUM=12
CONFIG_ESP_WIFI_TX_BA_WIN=4
CONFIG_ESP_WIFI_RX_BA_WIN=4
CONFIG_MBEDTLS_DYNAMIC_BUFFER=y
CONFIG_MBEDTLS_DYNAMIC_FREE_CONFIG_DATA=y
CONFIG_MBEDTLS_DYNAMIC_FREE_CA_CERT=y
# CONFIG_MBEDTLS_SSL_KEEP_PEER_CERTIFICATE is not set
CONFIG_MBEDTLS_SSL_IN_CONTENT_LEN=16384
CONFIG_MBEDTLS_SSL_OUT_CONTENT_LEN=2048
CONFIG_MBEDTLS_CERTIFICATE_BUNDLE=y
CONFIG_MBEDTLS_CERTIFICATE_BUNDLE_DEFAULT_FULL=y
# FATFS is used only for the SD card (512-byte sectors). A 4096 window wastes
# 3.5 KiB per mounted volume and another 3.5 KiB per open file.
CONFIG_FATFS_SECTOR_512=y
CONFIG_FATFS_LFN_HEAP=y
CONFIG_FATFS_MAX_LFN=128
# Router mode: forward AP client traffic to the STA uplink through NAPT.
CONFIG_LWIP_IP_FORWARD=y
CONFIG_LWIP_IPV4_NAPT=y
# CONFIG_LWIP_IPV4_NAPT_PORTMAP is not set

CONFIG_ESP_WIFI_SOFTAP_SUPPORT=y
```

## mini-WEB (M3-ESP-IDF_ver)/main/Kconfig.projbuild
```kconfig
menu "Mini WebServer M3"
    config M3_WEB_ASSET_LIMIT_KB
        int "PSRAM budget for SD Main WebFlie web files (KiB)"
        range 256 16384
        default 8192
    config M3_WEB_ASSET_MAX_FILES
        int "Maximum preloaded Main WebFlie files"
        range 8 4096
        default 512
    config M3_TOUCH_RESET
        int "GT911 reset GPIO (-1 if unconnected)"
        range -1 54
        default 3
    config M3_TOUCH_MIRROR_X
        bool "Mirror touchscreen X"
        default n
    config M3_TOUCH_MIRROR_Y
        bool "Mirror touchscreen Y"
        default n
endmenu

menu "Mini WEB automatic cloud connection"
    config MINI_WEB_RELAY_URL
        string "Factory cloud relay HTTPS endpoint"
        default "https://relay.audreaming.com"
    config MINI_WEB_PUBLIC_DOMAIN
        string "Factory public domain"
        default "audreaming.com"
    config MINI_WEB_PUBLIC_HOST
        string "Optional factory hostname"
        default ""
        help
            Empty uses m3-<board MAC>.PUBLIC_DOMAIN. Configure the matching
            Worker domain before shipment. Device token comes from factory
            NVS, never Wi-Fi UI.
endmenu
```

## mini-WEB (M4-ESP-IDF_ver)/main/Kconfig.projbuild
```kconfig
menu "Mini WebServer M4"
    choice M4_PANEL_VARIANT
        prompt "JC1060P470C panel revision"
        default M4_PANEL_V2
        config M4_PANEL_V1
            bool "V1 (no V2 rear label)"
        config M4_PANEL_V2
            bool "V2 (V2 on rear label)"
    endchoice
    config M4_LCD_RESET
        int "JD9165 LCD reset GPIO (-1 if unconnected)"
        range -1 54
        default 0
    config M4_LCD_BACKLIGHT
        int "Backlight GPIO"
        range 0 54
        default 23
    config M4_BACKLIGHT_ACTIVE_LOW
        bool "Invert backlight PWM"
        default n
    config M4_PORTRAIT_REVERSE
        bool "Reverse portrait orientation (270 instead of 90 degrees)"
        default n
    config M4_TOUCH_SWAP_XY
        bool "Swap touch X/Y before display rotation"
        default n
    menu "I2S pins (confirm the board revision)"
        config M4_I2S_MCLK
            int "MCLK GPIO"
            range 0 54
            default 13
        config M4_I2S_BCLK
            int "BCLK GPIO"
            range 0 54
            default 12
        config M4_I2S_LRCK
            int "LRCK GPIO"
            range 0 54
            default 10
        config M4_I2S_DOUT
            int "Speaker data GPIO"
            range 0 54
            default 9
        config M4_I2S_DIN
            int "Microphone data GPIO"
            range 0 54
            default 48
    endmenu
    config M4_WEB_ASSET_LIMIT_KB
        int "PSRAM budget for SD Main WebFlie web files (KiB)"
        range 256 16384
        default 8192
    config M4_WEB_ASSET_MAX_FILES
        int "Maximum preloaded Main WebFlie files"
        range 8 4096
        default 512
    config M4_TOUCH_RESET
        int "GT911 reset GPIO (-1 if unconnected)"
        range -1 54
        default -1
    config M4_TOUCH_MIRROR_X
        bool "Mirror touchscreen X"
        default n
    config M4_TOUCH_MIRROR_Y
        bool "Mirror touchscreen Y"
        default n
endmenu

menu "Mini WEB automatic cloud connection"
    config MINI_WEB_RELAY_URL
        string "Factory cloud relay HTTPS endpoint"
        default "https://relay.audreaming.com"
    config MINI_WEB_PUBLIC_DOMAIN
        string "Factory public domain"
        default "audreaming.com"
    config MINI_WEB_PUBLIC_HOST
        string "Optional factory hostname"
        default ""
        help
            Empty uses m4-<board MAC>.PUBLIC_DOMAIN. Configure the matching
            Worker domain before shipment. Device token comes from factory
            NVS, never Wi-Fi UI.
endmenu
```

## mini-WEB (P4-ESP-IDF_ver)/sdkconfig.defaults
```kconfig
CONFIG_IDF_TARGET="esp32p4"
CONFIG_ESPTOOLPY_FLASHSIZE_16MB=y
CONFIG_ESPTOOLPY_FLASHMODE_DIO=y
CONFIG_ESPTOOLPY_FLASHFREQ_80M=y
CONFIG_PARTITION_TABLE_CUSTOM=y
CONFIG_PARTITION_TABLE_CUSTOM_FILENAME="partitions_16mb.csv"
CONFIG_SPIRAM=y
CONFIG_SPIRAM_MODE_HEX=y
CONFIG_SPIRAM_SPEED_200M=y
CONFIG_SPIRAM_BOOT_INIT=y
CONFIG_SPIRAM_MEMTEST=y
CONFIG_SPIRAM_USE_MALLOC=y
CONFIG_SPIRAM_MALLOC_ALWAYSINTERNAL=1024
CONFIG_SPIRAM_MALLOC_RESERVE_INTERNAL=32768
CONFIG_MBEDTLS_DEFAULT_MEM_ALLOC=y
CONFIG_MBEDTLS_DYNAMIC_BUFFER=y
CONFIG_MBEDTLS_SSL_IN_CONTENT_LEN=16384
CONFIG_MBEDTLS_SSL_OUT_CONTENT_LEN=2048
CONFIG_MBEDTLS_CERTIFICATE_BUNDLE=y
CONFIG_MBEDTLS_CERTIFICATE_BUNDLE_DEFAULT_FULL=y
CONFIG_HTTPD_MAX_REQ_HDR_LEN=1024
CONFIG_HTTPD_MAX_URI_LEN=512
CONFIG_ESP_SYSTEM_EVENT_TASK_STACK_SIZE=4096
CONFIG_ESP_MAIN_TASK_STACK_SIZE=8192
CONFIG_FREERTOS_HZ=1000
CONFIG_LWIP_MAX_SOCKETS=16
CONFIG_LWIP_IPV6=y
CONFIG_LWIP_IPV6_AUTOCONFIG=y
CONFIG_LWIP_IPV6_NUM_ADDRESSES=5
CONFIG_FATFS_LFN_HEAP=y
CONFIG_FATFS_MAX_LFN=128

# Match the supplied camera example: early ESP32-P4 silicon (rev 1.x).
CONFIG_ESP32P4_SELECTS_REV_LESS_V3=y
CONFIG_ESP32P4_REV_MIN_100=y
CONFIG_IDF_EXPERIMENTAL_FEATURES=y
CONFIG_ESP_CONSOLE_UART_DEFAULT=y

# ESP-IDF 5.5 lane from Waveshare's Hosted Wi-Fi guidance.
CONFIG_ESP_WIFI_REMOTE_ENABLED=y
CONFIG_ESP_WIFI_REMOTE_LIBRARY_HOSTED=y
CONFIG_SLAVE_IDF_TARGET_ESP32C6=y
CONFIG_ESP_HOSTED_ENABLED=y
CONFIG_ESP_HOSTED_SDIO_HOST_INTERFACE=y
CONFIG_ESP_HOSTED_SDIO_4_BIT_BUS=y
CONFIG_ESP_HOSTED_SDIO_CLOCK_FREQ_KHZ=20000
CONFIG_ESP_HOSTED_SDIO_PIN_CLK=18
CONFIG_ESP_HOSTED_SDIO_PIN_CMD=19
CONFIG_ESP_HOSTED_SDIO_PIN_D0=14
CONFIG_ESP_HOSTED_SDIO_PRIV_PIN_D1_4BIT_BUS=15
CONFIG_ESP_HOSTED_SDIO_PIN_D2=16
CONFIG_ESP_HOSTED_SDIO_PIN_D3=17
CONFIG_ESP_HOSTED_SDIO_GPIO_RESET_SLAVE=54
CONFIG_ESP_HOSTED_SDIO_RESET_ACTIVE_LOW=y
CONFIG_WIFI_RMT_SOFTAP_SUPPORT=y
# Application NVS on the P4 is the single source of credentials.
# CONFIG_WIFI_RMT_NVS_ENABLED is not set
```

## mini-WEB (S3-ESP-IDF_ver)/sdkconfig.defaults
```kconfig
CONFIG_IDF_TARGET="esp32s3"
CONFIG_ESPTOOLPY_FLASHSIZE_8MB=y
CONFIG_ESPTOOLPY_FLASHSIZE="8MB"
CONFIG_PARTITION_TABLE_CUSTOM=y
CONFIG_PARTITION_TABLE_CUSTOM_FILENAME="partitions_8mb.csv"
CONFIG_PARTITION_TABLE_FILENAME="partitions_8mb.csv"
CONFIG_HTTPD_MAX_REQ_HDR_LEN=1024
CONFIG_HTTPD_MAX_URI_LEN=512
CONFIG_ESP_SYSTEM_EVENT_TASK_STACK_SIZE=4096
CONFIG_ESP_MAIN_TASK_STACK_SIZE=8192
CONFIG_FREERTOS_HZ=1000
CONFIG_LWIP_IPV6=y
CONFIG_LWIP_IPV6_AUTOCONFIG=y

CONFIG_LWIP_IPV6_NUM_ADDRESSES=5

CONFIG_LWIP_ND6=y

CONFIG_ESP_WIFI_SOFTAP_SUPPORT=y
CONFIG_MINI_WEB_RELAY_URL="https://relay-s3.audreaming.com"
CONFIG_MINI_WEB_PUBLIC_DOMAIN="audreaming.com"
```

## mini-WEB (S3-N16R8-SD-ESP-IDF_ver)/sdkconfig.defaults
```kconfig
CONFIG_IDF_TARGET="esp32s3"
CONFIG_ESPTOOLPY_FLASHSIZE_16MB=y
CONFIG_ESPTOOLPY_FLASHMODE_QIO=y
CONFIG_ESPTOOLPY_FLASHFREQ_80M=y
CONFIG_PARTITION_TABLE_CUSTOM=y
CONFIG_PARTITION_TABLE_CUSTOM_FILENAME="partitions_16mb.csv"
CONFIG_SPIRAM=y
CONFIG_SPIRAM_MODE_OCT=y
CONFIG_SPIRAM_TYPE_AUTO=y
CONFIG_SPIRAM_SPEED_80M=y
CONFIG_SPIRAM_BOOT_INIT=y
CONFIG_SPIRAM_MEMTEST=y
CONFIG_SPIRAM_USE_MALLOC=y
CONFIG_SPIRAM_MALLOC_ALWAYSINTERNAL=1024
CONFIG_SPIRAM_MALLOC_RESERVE_INTERNAL=32768
CONFIG_MBEDTLS_DEFAULT_MEM_ALLOC=y
CONFIG_MBEDTLS_DYNAMIC_BUFFER=y
CONFIG_MBEDTLS_SSL_IN_CONTENT_LEN=16384
CONFIG_MBEDTLS_SSL_OUT_CONTENT_LEN=2048
CONFIG_MBEDTLS_CERTIFICATE_BUNDLE=y
CONFIG_MBEDTLS_CERTIFICATE_BUNDLE_DEFAULT_FULL=y
CONFIG_HTTPD_MAX_REQ_HDR_LEN=1024
CONFIG_HTTPD_MAX_URI_LEN=512
CONFIG_ESP_SYSTEM_EVENT_TASK_STACK_SIZE=4096
CONFIG_ESP_MAIN_TASK_STACK_SIZE=8192
CONFIG_FREERTOS_HZ=1000
CONFIG_LWIP_MAX_SOCKETS=16
CONFIG_LWIP_IPV6=y
CONFIG_LWIP_IPV6_AUTOCONFIG=y
CONFIG_LWIP_IPV6_NUM_ADDRESSES=5
CONFIG_ESP_WIFI_STATIC_RX_BUFFER_NUM=6
CONFIG_ESP_WIFI_DYNAMIC_RX_BUFFER_NUM=16
CONFIG_ESP_WIFI_DYNAMIC_TX_BUFFER_NUM=16
CONFIG_FATFS_LFN_HEAP=y
CONFIG_FATFS_MAX_LFN=128

CONFIG_ESP_WIFI_SOFTAP_SUPPORT=y
```

## mini-WEB (S3-Zero-ESP-IDF_ver)/sdkconfig.defaults
```kconfig
CONFIG_IDF_TARGET="esp32s3"
CONFIG_ESPTOOLPY_FLASHSIZE_4MB=y
CONFIG_ESPTOOLPY_FLASHMODE_DIO=y
CONFIG_ESPTOOLPY_FLASHFREQ_80M=y
CONFIG_PARTITION_TABLE_CUSTOM=y
CONFIG_PARTITION_TABLE_CUSTOM_FILENAME="partitions_4mb.csv"
CONFIG_ESP_CONSOLE_USB_SERIAL_JTAG=y
CONFIG_ESP_CONSOLE_SECONDARY_NONE=y
CONFIG_SPIRAM=y
CONFIG_SPIRAM_MODE_QUAD=y
CONFIG_SPIRAM_SPEED_40M=y
CONFIG_SPIRAM_USE_MALLOC=y
CONFIG_SPIRAM_MALLOC_ALWAYSINTERNAL=16384
CONFIG_SPIRAM_MALLOC_RESERVE_INTERNAL=32768
CONFIG_ESP_DEFAULT_CPU_FREQ_MHZ_160=y
CONFIG_HTTPD_MAX_REQ_HDR_LEN=1024
CONFIG_HTTPD_MAX_URI_LEN=512
CONFIG_ESP_SYSTEM_EVENT_TASK_STACK_SIZE=4096
CONFIG_ESP_MAIN_TASK_STACK_SIZE=8192
CONFIG_FREERTOS_HZ=1000
CONFIG_LWIP_IPV6=y
CONFIG_LWIP_IPV6_AUTOCONFIG=y
CONFIG_LWIP_IPV6_NUM_ADDRESSES=5
CONFIG_ESP_WIFI_SOFTAP_SUPPORT=y
CONFIG_MBEDTLS_CERTIFICATE_BUNDLE=y
CONFIG_MBEDTLS_CERTIFICATE_BUNDLE_DEFAULT_FULL=y
CONFIG_MINI_WEB_RELAY_URL="https://relay-s3-zero.audreaming.com"
CONFIG_MINI_WEB_PUBLIC_DOMAIN="audreaming.com"
```
