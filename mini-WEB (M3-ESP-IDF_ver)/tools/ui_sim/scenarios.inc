/* Screens captured by sim_main.c. Each step uses the UI's own handlers. */
static void focus(lv_obj_t *field) { lv_obj_send_event(field, LV_EVENT_FOCUSED, NULL); settle(400); }
static void scroll_page(app_id_t app, int32_t y) { lv_obj_scroll_to_y(pages[app], y, LV_ANIM_OFF); settle(100); }
static void run_scenarios(const char *dir) {
    const char *lang = m3_i18n_language() == M3_LANG_EN ? "en" : m3_i18n_language() == M3_LANG_JA ? "ja" : "ko";
    char name[48];
#define SHOT(label) do { snprintf(name, sizeof(name), "%s_%s", lang, label); capture(dir, name); } while (0)
    SHOT("73_boot");
    if (boot_overlay) { lv_obj_delete(boot_overlay); boot_overlay = NULL; }
    SHOT("00_home");
    lv_tileview_set_tile_by_index(home_tiles, 0, 0, LV_ANIM_OFF); home_tile_changed(NULL);
    update_metrics(NULL); settle(200); SHOT("47_home_calendar");
    m3_calendar_shift(&calendar_year, &calendar_month, 1); calendar_follow = false; calendar_stamp = 0;
    update_calendar(); settle(200); SHOT("48_calendar_next_month");
    calendar_follow = true;
    lv_tileview_set_tile_by_index(home_tiles, 2, 0, LV_ANIM_OFF); home_tile_changed(NULL); settle(200); SHOT("49_home_more_apps");
    lv_tileview_set_tile_by_index(home_tiles, HOME_PHOTOS, 0, LV_ANIM_OFF); home_tile_changed(NULL);
    update_metrics(NULL); settle(200); SHOT("50_home_photos");
    m3_photos_pause(); update_metrics(NULL); settle(100); SHOT("51_photos_paused");
    sim_photos_empty = true; update_metrics(NULL); settle(100); SHOT("52_photos_empty");
    sim_photos_empty = false; sim_photos_busy = true; update_metrics(NULL); settle(100); SHOT("53_photos_sd_busy");
    sim_photos_busy = false; show_app(APP_HOME); settle(200);
    static const char *names[] = {"home", "wifi", "files", "recorder", "monitor", "settings", "radio", "games", "tts", "agent", "tube", "music", "gallery", "calculator", "ytmusic", "reader", "weather"};
    _Static_assert(sizeof(names) / sizeof(names[0]) == APP_COUNT, "Simulator app names must match the firmware");
    for (unsigned app = 1; app < APP_COUNT; ++app) {
        char label[32]; show_app((app_id_t)app); settle(400);
        snprintf(label, sizeof(label), "%02u_%s", app, names[app]); SHOT(label);
    }
    show_app(APP_WEATHER); focus(weather_query); SHOT("107_weather_keyboard"); hide_keyboard();
    lv_textarea_set_text(weather_query, "울산"); weather_search(NULL); settle(200); SHOT("108_weather_results");
    lv_obj_scroll_to_view(weather_presets[0], LV_ANIM_OFF); settle(200); SHOT("109_weather_presets_forecast");
    sim_weather.stale = true; sim_weather.status = M3_WEATHER_OFFLINE; update_weather();
    scroll_page(APP_WEATHER, 0); SHOT("110_weather_offline");
    sim_weather.valid = false; update_weather(); SHOT("111_weather_no_data");
    sim_weather.valid = true; sim_weather.stale = false; sim_weather.count = 0; sim_weather.status = M3_WEATHER_READY;
    show_app(APP_SYSTEM); lv_obj_scroll_to_view(sound_card, LV_ANIM_OFF); settle(200); SHOT("84_system_sounds");
    lv_obj_scroll_to_view(font_preview, LV_ANIM_OFF); settle(200); SHOT("100_system_font_gothic_16");
    segment_select(font_family_tabs,1); lv_slider_set_value(font_size_slider,20,LV_ANIM_OFF); typography_changed(NULL);
    lv_obj_scroll_to_view(font_preview,LV_ANIM_OFF); settle(200); SHOT("101_system_font_bold_20");
    segment_select(font_family_tabs,2); lv_slider_set_value(font_size_slider,24,LV_ANIM_OFF); typography_changed(NULL);
    lv_obj_scroll_to_view(font_preview,LV_ANIM_OFF); settle(200); SHOT("102_system_font_myeongjo_24");
    shade_set(true); settle(300); SHOT("103_service_stop_icons_font24"); shade_set(false);
    segment_select(font_family_tabs,0); lv_slider_set_value(font_size_slider,16,LV_ANIM_OFF); typography_changed(NULL);
    lv_obj_scroll_to_view(sound_card,LV_ANIM_OFF);
    accessibility_open(NULL); settle(200); SHOT("85_accessibility_voice");
    segment_select(guidance_mode, 1); guidance_changed(NULL); settle(200); SHOT("86_accessibility_tones");
    segment_select(guidance_mode, 0); guidance_changed(NULL); accessibility_open(NULL);
    show_app(APP_CALCULATOR);
    lv_textarea_set_text(calculator_input, "sin(30)+sqrt(81)^2");
    lv_label_set_text(calculator_result, "81.5"); settle(200); SHOT("74_calculator_scientific");
    show_app(APP_GALLERY); settle(200); SHOT("75_gallery_library");
    sim_playing = false; show_app(APP_RECORDER); settle(300); SHOT("68_recorder_idle");
    m3_audio_record(); sim_recorder.seconds = 42; sim_recorder.bytes = 1344000;
    snprintf(sim_recorder.message, sizeof(sim_recorder.message), "Recording to SD card");
    update_metrics(NULL); settle(200); SHOT("69_recorder_recording");
    m3_recorder_finish(); update_metrics(NULL); settle(200); SHOT("70_recorder_saved");
    snprintf(sim_recorder.message, sizeof(sim_recorder.message), "SD unavailable or busy");
    update_metrics(NULL); settle(200); SHOT("71_recorder_storage_error");
    sim_sd_ready = false; update_metrics(NULL); settle(200); SHOT("72_recorder_no_sd");
    sim_sd_ready = true;
    show_app(APP_MUSIC); settle(300); SHOT("40_music_sd");
    show_app(APP_FILES); settle(300); SHOT("46_files_unicode");
    show_app(APP_MUSIC); settle(300);
    m3_music_play(0, 1); update_metrics(NULL); settle(300); SHOT("41_music_playing");
    m3_music_shuffle(true); m3_music_repeat_mode(M3_MUSIC_REPEAT_ONE);
    update_metrics(NULL); settle(200); SHOT("82_music_shuffle_repeat_one");
    lv_obj_remove_flag(music_eq_panel, LV_OBJ_FLAG_HIDDEN); m3_music_equalizer(0, 6);
    update_metrics(NULL); lv_obj_scroll_to_view(music_eq_panel, LV_ANIM_OFF); settle(200); SHOT("83_music_equalizer");
    lv_obj_add_flag(music_eq_panel, LV_OBJ_FLAG_HIDDEN); lv_obj_scroll_to_y(pages[APP_MUSIC], 0, LV_ANIM_OFF);
    m3_music_pause(); update_metrics(NULL); settle(200); SHOT("42_music_paused");
    m3_audio_volume(150); update_metrics(NULL); settle(200); SHOT("43_music_boost150");
    m3_music_stop(); m3_music_refresh(false); segment_select(music_source, 1);
    update_metrics(NULL); settle(200); SHOT("44_music_flash");
    lv_obj_remove_flag(music_library, LV_OBJ_FLAG_HIDDEN);
    m3_music_page(1); update_metrics(NULL); lv_obj_scroll_to_view(music_library, LV_ANIM_OFF); settle(200); SHOT("45_music_page2");
    m3_audio_volume(40);
    show_app(APP_WIFI); settle(300); scroll_page(APP_WIFI, 560); SHOT("11_wifi_form");
    lv_obj_scroll_to_view(wifi_saved_count, LV_ANIM_OFF); settle(200); SHOT("11b_wifi_saved_profiles");
    scroll_page(APP_WIFI, 560);
    lv_obj_add_state(static_switch, LV_STATE_CHECKED); lv_obj_send_event(static_switch, LV_EVENT_VALUE_CHANGED, NULL);
    settle(100); scroll_page(APP_WIFI, 820); SHOT("12_wifi_static");
    focus(ssid_field); SHOT("13_keyboard_en");
    show_app(APP_TTS); settle(300); focus(tts_text); SHOT("14_keyboard_ko");
    lv_keyboard_set_mode(keyboard, LV_KEYBOARD_MODE_SPECIAL); settle(100); SHOT("15_keyboard_symbols");
    hide_keyboard(); show_app(APP_RADIO); settle(300); scroll_page(APP_RADIO, 360); SHOT("16_radio_stations");
    show_app(APP_GAMES); settle(300);
    for (int i = 0; i < 12; ++i) game_move((m3_game_direction_t)(i % 4));
    settle(100); SHOT("17_games_2048");
    segment_select(game_tabs, 1); choose_game(NULL);
    memory_visible[0] = memory_visible[5] = true; memory_solved[2] = memory_solved[9] = true; render_game(); settle(100);
    SHOT("18_games_memory");
    segment_select(game_tabs, 2); choose_game(NULL);
    m3_crossing_reset(&crossing, 7); render_game(); scroll_page(APP_GAMES, 100);
    SHOT("65_games_crossing");
    crossing.row = 1;
    while (m3_crossing_lane(&crossing, crossing.row) != M3_CROSS_RIVER) ++crossing.row;
    crossing.best_row = crossing.row; crossing.camera = crossing.row > 3 ? crossing.row - 3 : 0;
    crossing.x = (m3_crossing_offset(&crossing, crossing.row) + 40) % M3_CROSS_PERIOD;
    crossing.started = true; render_game(); SHOT("66_games_crossing_river");
    crossing.dead = true; render_game(); SHOT("67_games_crossing_over");
    show_app(APP_AGENT); settle(300); scroll_page(APP_AGENT, 400); SHOT("19_agent_input");
    show_app(APP_TTS); settle(300);
    lv_obj_send_event(lv_obj_get_child(lv_obj_get_parent(tts_text), 1), LV_EVENT_CLICKED, NULL);
    seen_voice = ~0u; update_metrics(NULL); settle(400);
    SHOT("20_voice_sheet");
    voice_cancel(NULL); show_app(APP_HOME); settle(300); shade_set(true); settle(500); SHOT("21_shade");
    shade_set(false); settle(400); show_app(APP_FILES); settle(300); scroll_page(APP_FILES, 300); SHOT("22_files_bottom");
    /* YouTube: empty, results, player and channel listing. */
    sim_playing = false;
    show_app(APP_TUBE); settle(300); update_metrics(NULL); settle(100); SHOT("26_tube_empty");
    lv_textarea_set_text(tube_query, m3_i18n_language() == M3_LANG_EN ? "NewJeans" : "뉴진스");
    tube_submit(); update_metrics(NULL); settle(300); SHOT("27_tube_results");
    scroll_page(APP_TUBE, 900); SHOT("28_tube_results_more");
    lv_obj_send_event(tube_rows[6].button, LV_EVENT_CLICKED, NULL);
    update_metrics(NULL); update_metrics(NULL); tube_frame_tick(NULL); settle(300); SHOT("29_tube_player");
    segment_select(tube_quality_tabs[1], M3_TUBE_STANDARD); m3_tube_quality(M3_TUBE_STANDARD);
    update_metrics(NULL); scroll_page(APP_TUBE, 480); SHOT("82_tube_quality");
    tube_save(NULL); update_metrics(NULL); settle(200); SHOT("83_tube_downloading");
    tube_cancel_save(NULL); sim_server_offline = true; update_metrics(NULL); settle(200); SHOT("84_tube_server_offline");
    sim_server_offline = false; sim_download.message[0] = 0;
    tube_channel_event(NULL); update_metrics(NULL); settle(300); SHOT("30_tube_channel");
    /* YouTube Music: empty, song results and a playing song. */
    tube_stop(); sim_player.active = false; ++sim_player.revision;
    show_app(APP_YTMUSIC); settle(300); update_metrics(NULL); settle(100); SHOT("77_ytmusic_empty");
    lv_textarea_set_text(ytm_query, m3_i18n_language() == M3_LANG_EN ? "IU" : "아이유");
    ytm_submit(); update_metrics(NULL); settle(300);
    lv_obj_send_event(ytm_rows[0].button, LV_EVENT_CLICKED, NULL);
    update_metrics(NULL); update_metrics(NULL); settle(300); SHOT("78_ytmusic_playing");
    scroll_page(APP_YTMUSIC, 700); SHOT("79_ytmusic_results");
    show_app(APP_HOME); settle(300);
    show_app(APP_SYSTEM); scroll_page(APP_SYSTEM, 0); SHOT("73_settings_display");
    segment_select(wake_tabs, M3_WAKE_DOUBLE_TAP); wake_mode_changed(NULL);
    update_metrics(NULL); SHOT("82_settings_double_tap");
    lv_obj_t *restart_button = lv_obj_get_child(lv_obj_get_parent(restart_info), 2);
    lv_obj_send_event(restart_button, LV_EVENT_CLICKED, NULL); settle(100); SHOT("83_restart_confirm");
    lv_obj_send_event(lv_obj_get_child(lv_obj_get_child(restart_confirm, 1), 0), LV_EVENT_CLICKED, NULL);
    if (sim_restart_count) { puts("Restart cancel failed"); exit(2); }
    shade_set(true); settle(300); SHOT("84_shade_screen_off");
    screen_off(NULL); settle(200); SHOT("85_screen_off_shield");
    sim_touch_down = true; settle(90); sim_touch_down = false; settle(90);
    sim_touch_down = true; settle(90); sim_touch_down = false; settle(300); SHOT("86_double_tap_wake");
    if (screen_blanked || screen_waking || !sim_screen_on) { puts("Double tap wake failed"); exit(2); }
    segment_select(wake_tabs, M3_WAKE_HOLD); wake_mode_changed(NULL); update_metrics(NULL);
    screen_off(NULL); settle(200); sim_touch_down = true; settle(2200);
    sim_touch_down = false; settle(300); SHOT("87_hold_wake");
    if (screen_blanked || screen_waking || !sim_screen_on) { puts("Hold wake failed"); exit(2); }
    shade_set(false); settle(300);
    show_app(APP_SYSTEM); lv_obj_scroll_to_view(sound_tabs, LV_ANIM_OFF); settle(100);
    SHOT("88_settings_sounds");
    show_app(APP_MONITOR); scroll_page(APP_MONITOR, 0);
    m3_runtime_web(M3_WEB_STOP_DOMAIN); update_metrics(NULL); settle(100); SHOT("89_web_domain_stopped");
    m3_runtime_web(M3_WEB_STOP_ALL); update_metrics(NULL); settle(100); SHOT("90_web_all_stopped");
    m3_runtime_web(M3_WEB_START_ALL); update_metrics(NULL);
    shade_set(true); settle(300); SHOT("91_status_sd_cpu_controls");
    sim_sd_ready = false; update_metrics(NULL); SHOT("92_status_no_sd");
    sim_sd_ready = true; shade_set(false); settle(300);
    scroll_page(APP_SYSTEM, 280); SHOT("74_settings_sound");
    scroll_page(APP_SYSTEM, 560); SHOT("75_settings_performance");
    scroll_page(APP_SYSTEM, 850); SHOT("76_settings_operation");
    sim_preferences.animations = 0; update_metrics(NULL); settle(200); SHOT("77_settings_no_effects");
    sim_preferences.animations = 1; update_metrics(NULL);
    /* Monitor web QR (local and internet) and waiting animations. */
    sim_playing = false; show_app(APP_MONITOR); settle(300); update_metrics(NULL); settle(100); SHOT("31_monitor_qr");
    segment_select(web_tabs, M3_WEB_IPV6); web_tab_changed(NULL); update_metrics(NULL); settle(100); SHOT("32_monitor_qr_ipv6");
    sim_ipv6_ready = false; update_metrics(NULL); settle(100); SHOT("62_monitor_ipv6_pending");
    sim_ipv6_ready = true;
    segment_select(web_tabs, M3_WEB_IPV4); web_tab_changed(NULL); update_metrics(NULL); settle(100); SHOT("63_monitor_qr_ipv4");
    segment_select(web_tabs, M3_WEB_MDNS); web_tab_changed(NULL); update_metrics(NULL); settle(100); SHOT("64_monitor_qr_mdns");
    segment_select(web_tabs, M3_WEB_DOMAIN); web_tab_changed(NULL);
    sim_online = false; update_metrics(NULL); settle(100); SHOT("65_monitor_domain_offline"); sim_online = true;
    segment_select(web_tabs, 0); web_tab_changed(NULL);
    sim_agent_busy = true; show_app(APP_AGENT); settle(300); update_metrics(NULL); settle(330); SHOT("33_agent_thinking");
    sim_agent_busy = false; update_metrics(NULL);
    sim_playing = true; show_app(APP_TTS); settle(200);
    sim_audio_message = "OpenAI TTS / downloading Korean audio..."; update_metrics(NULL); settle(330); SHOT("34_tts_preparing");
    sim_audio_message = "OpenAI TTS / AI-generated Korean speech"; update_metrics(NULL); settle(410); SHOT("35_tts_speaking");
    sim_audio_message = NULL; sim_playing = false; update_metrics(NULL);
    lv_obj_send_event(lv_obj_get_child(lv_obj_get_parent(tts_text), 1), LV_EVENT_CLICKED, NULL);
    sim_voice_recording = true; sim_mic_level = 0; update_metrics(NULL); settle(200); SHOT("36_voice_silent");
    sim_mic_level = 78; settle(200); SHOT("36_voice_speaking");
    sim_mic_level = 35; settle(120); SHOT("36_voice_quiet"); sim_mic_level = 0;
    sim_voice_recording = false; sim_voice_busy = true; update_metrics(NULL); settle(330); SHOT("37_voice_recognizing");
    sim_voice_busy = false; sim_voice_recording = true; voice_cancel(NULL); show_app(APP_HOME); settle(200);
    /* Switch language at runtime the way the Settings control does. */
    show_app(APP_SYSTEM); settle(200);
    segment_select(language_tabs, m3_i18n_language() == M3_LANG_EN ? 0 : 1); language_changed(NULL); settle(300);
    SHOT("23_switched_settings");
    show_app(APP_WIFI); settle(300); SHOT("24_switched_wifi");
    show_app(APP_HOME); settle(300); SHOT("25_switched_home");
    show_app(APP_SYSTEM); segment_select(language_tabs, M3_LANG_JA); language_changed(NULL); settle(200);
    capture(dir, "ja_54_settings");
    show_app(APP_HOME); settle(200); capture(dir, "ja_55_home");
    lv_tileview_set_tile_by_index(home_tiles, 0, 0, LV_ANIM_OFF); home_tile_changed(NULL);
    update_metrics(NULL); settle(200); capture(dir, "ja_56_calendar");
    show_app(APP_FILES); settle(200); capture(dir, "ja_57_files");
    show_app(APP_MUSIC); settle(300); capture(dir, "ja_58_music_marquee_start");
    settle(2500); capture(dir, "ja_59_music_marquee_later");
    show_app(APP_TUBE); settle(200); focus(tube_query);
    lv_textarea_set_text(tube_query, "ひらがなとカタカナ"); capture(dir, "ja_60_keyboard_hiragana");
    lv_keyboard_set_mode(keyboard, LV_KEYBOARD_MODE_USER_4); settle(200); capture(dir, "ja_61_keyboard_katakana");
    hide_keyboard();
    show_app(APP_GAMES); sd_apps_open(NULL); settle(200); SHOT("78_sd_apps_list");
    lv_obj_send_event(sd_rows[0], LV_EVENT_CLICKED, NULL); sd_apps_tick(NULL); settle(200); SHOT("79_sd_apps_game");
    sim_sd_app_error = true; sd_apps_tick(NULL); SHOT("80_sd_apps_error"); sim_sd_app_error = false;
    sd_apps_close(NULL); sd_apps_open(NULL); sim_sd_app_empty = true; sd_apps_tick(NULL); SHOT("81_sd_apps_empty");
    sim_sd_app_empty = false; sd_apps_close(NULL);
    show_app(APP_TTS); m3_audio_tts_provider(3); sim_audio_message = "Azure TTS / preparing Korean audio...";
    sim_playing = true; update_metrics(NULL); settle(250); SHOT("82_azure_tts");
    sim_audio_message = NULL; sim_playing = false; m3_voice_set_provider(3);
    show_app(APP_SYSTEM); update_metrics(NULL); settle(250); SHOT("83_azure_stt");
    show_app(APP_HOME);
    memset(&sim_power, 0, sizeof(sim_power)); update_metrics(NULL); settle(200); SHOT("84_power_unknown");
    sim_power = (m3_power_state_t){.battery_known=true, .wired_known=true, .wired=true};
    update_metrics(NULL); settle(200); SHOT("85_power_wired_only");
    sim_power = (m3_power_state_t){.battery_known=true, .battery_present=true, .percent_known=true,
        .percent=67, .wired_known=true};
    update_metrics(NULL); settle(200); SHOT("86_power_battery");
    sim_power.wired=true; sim_power.charge_known=true; sim_power.charging=true;
    update_metrics(NULL); settle(200); SHOT("87_power_charging");
    sim_power.percent=100; sim_power.charging=false;
    update_metrics(NULL); settle(200); SHOT("88_power_full_wired");
    sim_power.wired=false; sim_power.percent=9;
    update_metrics(NULL); settle(200); SHOT("89_power_low");
    memset(&sim_power, 0, sizeof(sim_power)); update_metrics(NULL);
    show_app(APP_READER); update_metrics(NULL); settle(200); SHOT("90_reader_empty");
    m3_reader_open("/books/example.txt"); reader_tick(); settle(200); SHOT("91_reader_sepia");
    reader_turn(1); settle(200); SHOT("92_reader_next");
    reader_settings_toggle(NULL); settle(200); SHOT("93_reader_settings");
    lv_slider_set_value(reader_sliders[0],32,LV_ANIM_OFF); lv_slider_set_value(reader_sliders[2],14,LV_ANIM_OFF);
    segment_select(reader_theme,2); reader_configure_ui(NULL); reader_settings_toggle(NULL);
    settle(200); SHOT("94_reader_night_large");
    reader_settings_toggle(NULL); segment_select(reader_theme,0); segment_select(reader_background,2);
    lv_slider_set_value(reader_sliders[0],20,LV_ANIM_OFF); reader_configure_ui(NULL); reader_settings_toggle(NULL);
    settle(200); SHOT("95_reader_ruled");
    reader_settings_toggle(NULL); segment_select(reader_theme,3); segment_select(reader_background,1);
    reader_configure_ui(NULL); reader_settings_toggle(NULL); settle(200); SHOT("96_reader_green_paper");
    reader_settings_toggle(NULL); segment_select(reader_family,1);
    reader_configure_ui(NULL); reader_settings_toggle(NULL); settle(200); SHOT("96b_reader_gothic_bold");
    reader_settings_toggle(NULL); segment_select(reader_family,2);
    lv_slider_set_value(reader_sliders[0],36,LV_ANIM_OFF);
    reader_configure_ui(NULL); reader_settings_toggle(NULL); settle(200); SHOT("96c_reader_myeongjo_36");
    sim_reader.status=M3_READER_ENCODING; reader_tick(); settle(200); SHOT("97_reader_encoding_error");
    show_app(APP_HOME);
    sim_playing = false; sim_player.active = false; ++sim_player.revision;
    show_app(APP_TUBE); lv_textarea_set_text(tube_query, "YOASOBI アイドル"); tube_submit();
    snprintf(sim_tube.items[0].title, sizeof(sim_tube.items[0].title), "夜に駆ける / 日本語タイトル");
    snprintf(sim_tube.items[0].channel, sizeof(sim_tube.items[0].channel), "日本語チャンネル");
    ++sim_tube.revision; update_metrics(NULL); settle(200); SHOT("98_tube_japanese");
    show_app(APP_YTMUSIC); lv_textarea_set_text(ytm_query, "YOASOBI アイドル"); ytm_submit();
    snprintf(sim_music.items[0].title, sizeof(sim_music.items[0].title), "夜に駆ける / 日本語タイトル");
    snprintf(sim_music.items[0].channel, sizeof(sim_music.items[0].channel), "日本語チャンネル");
    ++sim_music.revision; update_metrics(NULL);
    lv_obj_send_event(ytm_rows[0].button, LV_EVENT_CLICKED, NULL);
    update_metrics(NULL); update_metrics(NULL); settle(200); SHOT("99_music_cover");
    scroll_page(APP_YTMUSIC, 700); settle(200); SHOT("100_music_artwork_rows");
    show_app(APP_HOME); lv_tileview_set_tile_by_index(home_tiles, 2, 0, LV_ANIM_OFF);
    home_tile_changed(NULL); settle(200); SHOT("101_music_icon");
    show_app(APP_HOME); lv_tileview_set_tile_by_index(home_tiles, 0, 0, LV_ANIM_OFF);
    home_tile_changed(NULL); settle(200); SHOT("102_shared_calendar_wallpaper");
    lv_tileview_set_tile_by_index(home_tiles, 2, 0, LV_ANIM_OFF);
    home_tile_changed(NULL); settle(200); SHOT("103_extra_apps_3x3");
    shade_set(true); settle(1100); update_metrics(NULL); SHOT("104_cpu_and_service_icons"); shade_set(false);
    show_app(APP_RADIO); segment_select(radio_transport, 1); radio_select(13);
    settle(200); SHOT("105_radio_classic_and_quality");
    show_app(APP_GALLERY); settle(250); SHOT("106_gallery_media_grid");
    gallery_grid_enter(1); settle(250); SHOT("107_gallery_grid_page2");
    gallery_show_path(gallery_catalog.items[0].path,0); settle(250); SHOT("108_gallery_image_detail");
    gallery_library_open(NULL); settle(250); gallery_show_path(gallery_catalog.items[1].path,1);
    settle(250); SHOT("109_gallery_video_detail");
    show_app(APP_YTMUSIC); lv_obj_scroll_to_y(pages[APP_YTMUSIC],0,LV_ANIM_OFF);
    ytm_queue[1]=ytm_queue[0]; snprintf(ytm_queue[1].id,sizeof(ytm_queue[1].id),"bbbbbbbbbbb");
    ytm_queue_count=2; ytm_prepare_pair(); sim_music_cache_loading=true;
    update_metrics(NULL); settle(250); SHOT("110_music_next_prefetch");
    sim_music_cache_loading=false; update_metrics(NULL); settle(250); SHOT("111_music_psram_ready");
    lv_obj_send_event(ytm_save,LV_EVENT_CLICKED,NULL); update_metrics(NULL); settle(250); SHOT("112_music_sd_download");
#undef SHOT
}
